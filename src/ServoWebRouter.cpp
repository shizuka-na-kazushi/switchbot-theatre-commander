
#include "ServoWebRouter.h"
#include "BinFiles.h"
#include "CallSwitchbot.h"
#include "SceneSecret.h"

static int LevelToServoDegs[] = {0, 20, 40, 60};

void ServoWebServer::overridePath(HeaderInfo& header) {
  if (header.path == "/") {
    header.path = String("/index.html");
  }
}

boolean ServoWebServer::dispatch(HeaderInfo& header, WiFiClient& client) 
{
  overridePath(header);

  if (header.command == "GET") {

    /** api or custom routers */
    WEB_ROUTE_MACRO_BEGIN()
    WEB_ROUTE_EXECUTE_2("/level0", respondWithChangeLevel, 0, m_pServo)
    WEB_ROUTE_EXECUTE_2("/level1", respondWithChangeLevel, 1, m_pServo)
    WEB_ROUTE_EXECUTE_2("/level2", respondWithChangeLevel, 2, m_pServo)
    WEB_ROUTE_EXECUTE_2("/level3", respondWithChangeLevel, 3, m_pServo)

    WEB_ROUTE_EXECUTE_1("/theatreOn",     respondExecuteSwitchbotScene, SWITCHBOT_SCENE_ID_THEATRE_ON)
    WEB_ROUTE_EXECUTE_1("/theatreOff",    respondExecuteSwitchbotScene, SWITCHBOT_SCENE_ID_THEATRE_OFF)
    WEB_ROUTE_EXECUTE_1("/runTheatreOn",  respondExecuteSwitchbotSceneWithRedirect, SWITCHBOT_SCENE_ID_THEATRE_ON)
    WEB_ROUTE_MACRO_END()

    /** static files (implemented in 'BinFiles.cpp' which was generated by "build-contents.js") */
    if (!dispatchBinFiles(header, client)) {
      return respondNoResource(header, client);
    }

    return true;
  } else {
    return respondGenericError(header, client);
  }
}

boolean respondWithChangeLevel(const HeaderInfo& header, WiFiClient& client, int level, Servo* pServo) 
{
    if (pServo && (0 <= level) && (level < sizeof(LevelToServoDegs) / sizeof(LevelToServoDegs[0]))) {
      Serial.print("\nLevel= ");
      Serial.print(level);
      Serial.print("; deg= ");
      Serial.print(LevelToServoDegs[level]);
      Serial.println("");Serial.println("");

      pServo->write(LevelToServoDegs[level]);
    }

    client.println("HTTP/1.1 200 OK");
    client.println("Content-Type: application/json");
    client.println("Connection: close");
    client.println();

    client.println("{code: \"success\"}");

    return true;
}

boolean respondExecuteSwitchbotScene(const HeaderInfo& header, WiFiClient& client, const String& sceneId) 
{
  CallSwitchbot callSwitchbot;

  // faviconレスポンス
  client.println("HTTP/1.1 200 OK");
  client.println("Content-Type: application/json");
  client.println("Connection: close");
  client.println();

  if (callSwitchbot.executeScene(sceneId)) {
    client.println("{code: \"success\"}");
    return true;
  } else {
    client.println("{error: \"internal error\"}");
    return true;
  }
}

boolean respondExecuteSwitchbotSceneWithRedirect(const HeaderInfo& header, WiFiClient& client, const String& sceneId) 
{
  CallSwitchbot callSwitchbot;

  // faviconレスポンス
  client.println("HTTP/1.1 301 Moved Permanently");
  client.println("Location: /");
  client.println("Cache-Control: no-store, no-cache, must-revalidate");
  client.println("Pragma: no-cache");
  client.println("Expires: 0");
  client.println("Connection: close");
  client.println();

  callSwitchbot.executeScene(sceneId);
  return true;
}
